.INCLUDE "M324PADEF.INC"  ; INCLUDE ATMEGA324PA DEFINITIONS 
.DEF SHIFTDATA = R20     
; DEFINE THE SHIFT DATA REGISTER 
.EQU CLEARSIGNALPORT = PORTB   ; SET CLEAR SIGNAL PORT TO PORTB 
.EQU CLEARSIGNALPIN = 3        
; SET CLEAR SIGNAL PIN TO PIN 0 OF PORTB 
.EQU SHIFTCLOCKPORT = PORTB    
.EQU SHIFTCLOCKPIN = 2         
.EQU LATCHPORT = PORTB       
.EQU LATCHPIN = 1              
.EQU SHIFTDATAPORT = PORTB     
.EQU SHIFTDATAPIN = 0          
; SET SHIFT CLOCK PORT TO PORTB 
; SET SHIFT CLOCK PIN TO PIN 1 OF PORTB 
; SET LATCH PORT TO PORTB 
; SET LATCH PIN TO PIN 0 OF PORTB 
; SET SHIFT DATA PORT TO PORTB 
; SET SHIFT DATA PIN TO PIN 3 OF PORTB 
MAIN: 
STOP: 
			CALL INITPORT 
			LDI  SHIFTDATA, 0X55 
			CALL CLEARDATA 
			CALL SHIFTOUTDATA 
			JMP  STOP 
; INITIALIZE PORTS AS OUTPUTS 
INITPORT: 
			LDI R24, (1<<CLEARSIGNALPIN)|(1<<SHIFTCLOCKPIN)|(1<<LATCHPIN)|(1<<SHIFTDATAPIN)  
			 OUT DDRB, R24        ; SET DDRB TO OUTPUT 
			 RET 
			 LDI SHIFTDATA,0X55 
CLEARDATA: 
			 CBI CLEARSIGNALPORT, CLEARSIGNALPIN       ; SET CLEAR SIGNAL PIN TO LOW                              
			; WAIT FOR A SHORT TIME 
			 SBI CLEARSIGNALPORT, CLEARSIGNALPIN       ; SET CLEAR SIGNAL PIN TO HIGH 
			 RET 
			; SHIFT OUT DATA 
SHIFTOUTDATA: 
			 CBI SHIFTCLOCKPORT, SHIFTCLOCKPIN       ; 
			 LDI R18, 8               ; SHIFT 8 BITS 
SHIFTLOOP: 
			   SBRC SHIFTDATA, 7      ; CHECK IF THE MSB OF SHIFTDATA IS 1 
			   SBI SHIFTDATAPORT, SHIFTDATAPIN   ; SET SHIFT DATA PIN TO HIGH 
			   SBI SHIFTCLOCKPORT, SHIFTCLOCKPIN   ; SET SHIFT CLOCK PIN TO HIGH 
			   LSL SHIFTDATA           ; SHIFT LEFT 
			   CBI SHIFTCLOCKPORT, SHIFTCLOCKPIN   ; SET SHIFT CLOCK PIN TO LOW 
			   CBI SHIFTDATAPORT, SHIFTDATAPIN   ; SET SHIFT DATA PIN TO LOW 
			   DEC R18 
			   BRNE SHIFTLOOP 
			; LATCH DATA 
			 SBI LATCHPORT, LATCHPIN   ; SET LATCH PIN TO HIGH 
			 CBI LATCHPORT, LATCHPIN   ; SET LATCH PIN TO LOW 
			 RET 